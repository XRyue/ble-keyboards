## config/boards/shields/ble_keyboards/Kconfig.defconfig
```kconfig
# Copyright (c) 2020 The ZMK Contributors
# SPDX-License-Identifier: MIT

if SHIELD_BLE_KEYBOARDS
config ZMK_KEYBOARD_NAME
	default "XRyue"

endif
```

## config/boards/shields/ble_keyboards/Kconfig.shield
```kconfig
# Copyright (c) 2020 The ZMK Contributors
# SPDX-License-Identifier: MIT

config SHIELD_BLE_KEYBOARDS
	def_bool $(shields_list_contains,XRyue)
```

## config/boards/shields/xryue45/Kconfig.defconfig
```kconfig
# Copyright (c) 2020 The ZMK Contributors
# SPDX-License-Identifier: MIT

if SHIELD_xryue45

config ZMK_KEYBOARD_NAME
	default "jiage666"

endif
```
